## conf/distro/homeassistant.conf
```bitbake
require conf/distro/poky.conf
include conf/distro/include/ha-versions.inc

DISTRO = "homeassistant"
DISTRO_NAME = "HomeAssistant Linux Distro"
DISTRO_VERSION = "0.1"

DISTRO_FEATURES += "systemd"
```
